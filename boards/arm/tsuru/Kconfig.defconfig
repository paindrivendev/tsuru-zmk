## boards/arm/tsuru/Kconfig.defconfig
```kconfig
# tsuru board configuration 
# Copyright (c) 2023 Pete Johanson
# SPDX-License-Identifier: Apache-2.0

config BOARD
	default "tsuru"
	depends on BOARD_TSURU

config ZMK_USB
	default y if BOARD_TSURU
```
